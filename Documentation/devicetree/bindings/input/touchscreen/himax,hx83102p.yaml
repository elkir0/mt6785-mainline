## Documentation/devicetree/bindings/input/touchscreen/himax,hx83102p.yaml
```yaml
# SPDX-License-Identifier: (GPL-2.0-only OR BSD-2-Clause)
%YAML 1.2
---
$id: http://devicetree.org/schemas/input/touchscreen/himax,hx83102p.yaml#
$schema: http://devicetree.org/meta-schemas/core.yaml#

title: Himax HX83102 TDDI touchscreen and pen controller

maintainers:
  - The Lenovomarchy authors

description: |
  The HX83102 is a touch and display driver integrated (TDDI) device.
  Its touch MCU has no firmware flash: the host uploads the touch
  firmware into the chip SRAM over SPI after every power-up, resume and
  exception, then verifies it with the chip's CRC engine. The controller
  reports up to ten fingers and one active pen with pressure, tilt and
  barrel buttons.

  The touch firmware must be present in /lib/firmware (default
  himax/hx83102p.bin, override with firmware-name).

allOf:
  - $ref: touchscreen.yaml#
  - $ref: /schemas/spi/spi-peripheral-props.yaml#

properties:
  compatible:
    const: himax,hx83102p-ts

  reg:
    maxItems: 1

  spi-max-frequency: true

  interrupts:
    maxItems: 1
    description: Touch interrupt (TSIX), falling edge

  reset-gpios:
    maxItems: 1
    description: External reset (XRES), active low, shared with the
      display side of the TDDI chip

  firmware-name:
    $ref: /schemas/types.yaml#/definitions/string
    description: |
      Name of the zero-flash touch firmware file to request from the
      firmware loader. Defaults to himax/hx83102p.bin.

  panel: true

  touchscreen-inverted-x: true
  touchscreen-inverted-y: true
  touchscreen-size-x: true
  touchscreen-size-y: true
  touchscreen-swapped-x-y: true

required:
  - compatible
  - reg
  - interrupts
  - reset-gpios
  - touchscreen-size-x
  - touchscreen-size-y

unevaluatedProperties: false

examples:
  - |
    #include <dt-bindings/gpio/gpio.h>
    #include <dt-bindings/interrupt-controller/irq.h>

    spi {
        #address-cells = <1>;
        #size-cells = <0>;

        touchscreen@0 {
            compatible = "himax,hx83102p-ts";
            reg = <0>;
            spi-max-frequency = <9600000>;
            interrupt-parent = <&pio>;
            interrupts = <1 IRQ_TYPE_EDGE_FALLING>;
            reset-gpios = <&pio 2 GPIO_ACTIVE_LOW>;
            firmware-name = "himax/hx83102p.bin";
            panel = <&panel>;
            touchscreen-size-x = <1200>;
            touchscreen-size-y = <2000>;
        };
    };

...
```

## Documentation/devicetree/bindings/media/i2c/samsung,s5k4h7.yaml
```yaml
# SPDX-License-Identifier: (GPL-2.0-only OR BSD-2-Clause)
%YAML 1.2
---
$id: http://devicetree.org/schemas/media/i2c/samsung,s5k4h7.yaml#
$schema: http://devicetree.org/meta-schemas/core.yaml#

title: Samsung S5K4H7 Image Sensor

description:
  Samsung S5K4H7 (S5K4H7YX family, chip ID 0x487b) 8Mpixel raw image
  sensor. The sensor is controlled over a CCI (I2C-compatible) bus, the
  widest supported output image frame size is 3264x2448 at 30 frames
  per second, data output format is RAW10 transferred over a 4-lane
  MIPI D-PHY interface at 700 Mbps per lane.

maintainers:
  - Anthony Dhaene <anthony.dhaene@gmail.com>

allOf:
  - $ref: /schemas/media/video-interface-devices.yaml#

properties:
  compatible:
    const: samsung,s5k4h7

  reg:
    description: I2C slave address of the sensor.
    maxItems: 1

  clocks:
    description: MCLK supply clock, 24 MHz.
    maxItems: 1

  reset-gpios:
    description: |
      Active low GPIO connected to the RESET pad of the sensor. On the
      reference implementation the line is high while the sensor runs
      and is pulled low to enter hardware reset.
    maxItems: 1

  avdd-supply:
    description: Analogue voltage supply, 2.8 volts.

  dvdd-supply:
    description: Digital core voltage supply, 1.05 - 1.2 volts.

  dovdd-supply:
    description: Digital I/O voltage supply, 1.8 volts.

  port:
    $ref: /schemas/graph.yaml#/$defs/port-base
    additionalProperties: false

    properties:
      endpoint:
        $ref: /schemas/media/video-interfaces.yaml#
        unevaluatedProperties: false

        properties:
          data-lanes:
            items:
              - const: 1
              - const: 2
              - const: 3
              - const: 4

        required:
          - data-lanes
          - link-frequencies

    required:
      - endpoint

required:
  - compatible
  - reg
  - clocks
  - port

unevaluatedProperties: false

examples:
  - |
      #include <dt-bindings/gpio/gpio.h>

      i2c {
          #address-cells = <1>;
          #size-cells = <0>;

          camera@2d {
              compatible = "samsung,s5k4h7";
              reg = <0x2d>;

              clocks = <&camtg3_clk>;
              assigned-clocks = <&camtg3_clk>;
              assigned-clock-rates = <24000000>;
              reset-gpios = <&pio 124 GPIO_ACTIVE_LOW>;
              avdd-supply = <&cam_vcama_reg>;
              dvdd-supply = <&cam_vcamd_reg>;
              dovdd-supply = <&mt6359_vcamio_ldo_reg>;

              port {
                  s5k4h7_out: endpoint {
                      remote-endpoint = <&seninf_in>;
                      data-lanes = <1 2 3 4>;
                      link-frequencies = /bits/ 64 <700000000>;
                  };
              };
          };
      };
...
```

## drivers/media/platform/mediatek/mt6785-cam/Kconfig
```kconfig
# SPDX-License-Identifier: GPL-2.0-only

config VIDEO_MEDIATEK_MT6785_CAM
	tristate "MediaTek MT6785 camera (SENINF CSI-2 receiver + CAMSV0 capture)"
	depends on V4L_PLATFORM_DRIVERS
	depends on VIDEO_DEV
	depends on (ARCH_MEDIATEK && OF) || COMPILE_TEST
	depends on PM
	select MEDIA_CONTROLLER
	select VIDEOBUF2_CORE
	select VIDEOBUF2_V4L2
	select VIDEOBUF2_DMA_CONTIG
	select VIDEOBUF2_MEMOPS
	select V4L2_FWNODE
	select V4L2_ASYNC
	help
	  Camera support for the MediaTek MT6785 (Helio G90T) SoC: a V4L2
	  subdev for the SENINF MIPI CSI-2 sensor interface (binding sensor
	  subdevs through the device tree endpoints) and a video capture
	  node for CAMSV0, the raw-frame DMA pipe through SENINF mux 2.
	  Frames are captured as MIPI-packed 10-bit Bayer (V4L2_PIX_FMT_S*10P)
	  into physically contiguous buffers with the camera LARB SMI MMU
	  bypassed; proper IOMMU support is not implemented yet.

	  To compile this driver as modules choose M here: the modules will
	  be called mt6785-seninf and mt6785-camsv.
```

## drivers/staging/yt11-cam/Kconfig
```kconfig
# SPDX-License-Identifier: GPL-2.0
config YT11_CAM_PROBE
	tristate "Lenovo Yoga Tab 11 (YT-J706F) camera power-up probe"
	depends on ARCH_MEDIATEK || COMPILE_TEST
	depends on OF && COMMON_CLK && PINCTRL && REGULATOR && GPIOLIB
	help
	  Say Y or M here for the YT-J706F M0 camera bring-up probe driver.
	  It exposes a debugfs interface under /sys/kernel/debug/yt11-cam/
	  to power one camera slot at a time and enable its 24 MHz CAMTG
	  master clock so userspace can probe sensor chip IDs over I2C.

config MT6785_SENINF_TM
	tristate "MediaTek MT6785 SENINF test-model bring-up driver"
	depends on ARCH_MEDIATEK || COMPILE_TEST
	depends on OF && COMMON_CLK && PM
	help
	  Say Y or M here for the MT6785 SENINF test-pattern bring-up driver.
	  It exposes /sys/kernel/debug/seninf-tm/ (power, start, dump) to
	  verify the CAM power domain, SENINF clocks, and SENINF0 -> MUX0 ->
	  CAM_MUX0 test-pattern generation without a sensor or DMA.

config MT6785_CAMSV_TM
	tristate "MediaTek MT6785 CAMSV0 capture test-harness driver"
	depends on ARCH_MEDIATEK || COMPILE_TEST
	depends on OF && COMMON_CLK && PM && HAS_DMA
	help
	  Say Y or M here for the MT6785 CAMSV0 test-capture driver.
	  It exposes /sys/kernel/debug/camsv-tm/ (power, buf, fill, w, r,
	  bufdump, frame) to drive SENINF/ANA/CAMSV0/CAMSYS registers and
	  capture raw frames into a coherent DMA buffer.
```
